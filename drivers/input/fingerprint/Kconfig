## drivers/input/fingerprint/Kconfig
```kconfig
#
#Fingerprint
#
menu "Fingerprint support"
	depends on INPUT

config MTK_FINGERPRINT_SUPPORT
	bool "Mediatek Fingerprint"
	default n
	help
	  Fingerprint mtk driver enable/disable
	  in the kernel.Say Y here if you want to
	  use mediatek fingerprint driver,fingerprint
	  driver will support fingerprint function

config MTK_FINGERPRINT_SELECT
	string "sensor type"
	default "ft9362_tee"

if MTK_FINGERPRINT_SELECT = "ft9362_tee"
  config FT9362_FINGERPRINT_TEE
     bool "FT9362 TEE Fingerprint"
     default y
     ---help---
     MICROARRAY fingerprint FT9362 TEE's device.
endif

config PRIZE_FP_USE_VFP
	bool "Fingerprint power vfp"
	default n
	help
	  CHIPONE fingerprint CHIPONE's device.
endmenu
```

## drivers/input/touchscreen/mediatek/Kconfig
```kconfig
#
# Touchscreen driver configuration
#
menuconfig INPUT_TOUCHSCREEN
	bool "Touchscreens"
	help
	  Say Y here, and a list of supported touchscreens will be displayed.
	  This option doesn't affect the kernel.

	  If unsure, say Y.

if INPUT_TOUCHSCREEN

config TOUCHSCREEN_MTK
	bool "MediaTek Touch Panel Driver"
	help
	  Say Y here if you have MediaTek touch panel.

	  If unsure, say N.

	  To compile this dirver as a module, choose M here: the
	  module will be called.

config TOUCHSCREEN_MTK_ILITEK_V3
	bool "ILITEK chipset i2c touchscreen"
	help
	  This enables support for ILITEK CHIPSET over I2C based touchscreens.
	  when turn this option on, TOUCHSCREEN_ILITEK_I2C touch driver
	  will open.
	  If unsure,say N.
endif

config FURILABS_ILITEK_PALMREJECTION
        bool "FuriLabs palm rejection for ILITEK_V3 touchscreen"
        depends on TOUCHSCREEN_MTK_ILITEK_V3
        default n
        help
          Enable palm rejection mode support for ILITEK_V3 touchscreen.
```

## drivers/power/supply/mediatek/charger/Kconfig
```kconfig
config MTK_CHARGER
	bool "MediaTek Charging Driver"
	depends on MEDIATEK_SOLUTION
	help
	  Say yes here to enable MediaTek charging driver.
	  This driver contains charging control flow and
	  maintains charging status.
	  Say no if not using MediaTek charging driver.

config POWER_EXT
	bool "MediaTek Power Ext"
	help
	  Check this if the device is not powered by battery.
	  For example, if the device is powered by AC adapter.
	  Select No if the device needs info about
	  battery voltage, temperature, etc.

config MTK_SWCHR_SUPPORT
	bool "MediaTek switch charger"
	depends on MTK_CHARGER
	help
	  This is to enable switching charger control flow.
	  switching charger has better performance than pulse charger
	  Set to yes if switching charger is used.
	  Set to no if pmic pulse charger is used.

config MTK_KERNEL_POWER_OFF_CHARGING
	bool "MTK kernel power off charging"
	depends on MTK_CHARGER
	help
	  yes : support KPOC feature, power off charging would running by
	  kernel and charging animation by kpoc service. no: not support KPOC
	  feature.
	  device won't enter charging mode if config is no.

config MTK_PUMP_EXPRESS_PLUS_SUPPORT
	bool "MediaTek PUMP EXPRESS PLUS"
	depends on MTK_CHARGER
	help
	  Fast charging technology using switch charger and current pattern
	  to achive better charging ability.
	  Set Yes to enable PE+
	  Set No to disable PE+

config MTK_PUMP_EXPRESS_PLUS_20_SUPPORT
	bool "MediaTek PUMP EXPRESS PLUS 2.0"
	depends on MTK_CHARGER
	help
	  Fast charging technology using switch charger and current pattern
	  to achive better charging ability. It has higher charging efficiency
	  and has better thermal performance than PE+.
	  Set Yes to enable PE+2.0
	  Set No to disable PE+2.0

config MTK_PUMP_EXPRESS_50_SUPPORT
	bool "Mediatek Pump Express 5.0"
	select RT_PROP_CHGALGO
	depends on MTK_CHARGER
	help
	  Fast charging technology using divider charger to achieve better
	  charging ability. It has higher charging efficiency and better
	  thermal performance than using switching charger.
	  Set Yes to enable PE5.0
	  Set No to disable PE5.0

config SWCHR_POWER_PATH
	bool "External charger IC supports powerpath"
	depends on MTK_CHARGER
	help
	  Set Yes if the external charger IC
	  supports power path function.
	  This affects setting of auxadc channels
	  used to representing voltage of system
	  or battery.

config CHARGER_MT6362
	tristate "MT6362 SPMI CHG driver"
	depends on MFD_MT6362
	help
	  Say yes here to have support for the MT6362 CHG
	  It supports BC1.2 and OTG boost.
	  The driver can also be build as a module.
	  If so, the module will be called mt6362_chg

config CHARGER_SC8551
	tristate "Richtek SC8551 Divider Charger Driver"
	depends on MTK_CHARGER
	help
	  Say Y here to enable support of SC8551 divider charger
	  It is mainly used as divider charger for
	  direct charge
	  It depends on config MTK_CHARGER

config RT_PROP_CHGALGO
	bool "Richtek Proprietary Charging Algorithm"
	help
	  Say Y to enable
	  Richtek Proprietary charging algorithm
	  Say N to disable
	  Richtek Proprietary charging algorithm

# prize add by sunshuai for A-C 30w charge 20201109-start
config  PRIZE_ATOC_TYPEC_CHARGE
	bool "A-C 30w charge"
	default n
	help
	  Set to Yes if A-C 30w charge is used.
# prize add by sunshuai for A-C 30w charge 20201109-end

config MTK_CHARGER_UNLIMITED
	bool "MediaTek Charger Unlimited"
	depends on MTK_CHARGER
	help
	  Say Yes to release charging current restrictions.
	  Say No to not release charging current restrictions.
	  It is mainly used for long-term tests.
	  It depends on config MTK_CHARGER.

#//prize added by sunshuai, mt5725-15W support, 20200507-start
config PRIZE_MT5725_SUPPORT_15W
	bool "PRIZE_MT5725_SUPPORT_15W"
	default n
	help
	  Set to Yes if mt5725_15W is used.
#//prize added by sunshuai, mt5725-15W support, 20200507-end
config PRIZE_MT5725_SUPPORT_15W_NEW
	bool "PRIZE_MT5725_SUPPORT_15W_NEW"
	default n
	help
	  Set to Yes if mt5725_15W is used.

config PRIZE_ONLY5W_DISPLAY_15W
	bool "PRIZE_ONLY5W_DISPLAY_15W"
	default n
	help
	  Set to Yes if mt5725_15W is used.
```
